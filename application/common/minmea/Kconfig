## application/common/minmea/Kconfig
```kconfig
module = MINMEA
module-str = minmea
source "subsys/logging/Kconfig.template.log_config"
```

## application/common/protocol/Kconfig
```kconfig
module = PROTOCOL
module-str = protocol
source "subsys/logging/Kconfig.template.log_config"
```

## application/flight_controller/modules/dummysensor/drivers/sensor/dummysensor/Kconfig
```kconfig
config DUMMYSENSOR
	bool "dummy sensor"
	default n
	depends on DT_HAS_AESIR_DUMMYSENSOR_ENABLED


choice
	prompt "select data source for the dummy sensor"
	config DUMMYSENSOR_AESIR
		bool "aesir data"
	config DUMMYSENSOR_ASAT
		bool "asat data"
	config DUMMYSENSOR_ASTG
		bool "astg data"
	config DUMMYSENSOR_BRISTOL
		bool "bristol data"
	config DUMMYSENSOR_FARADAY
		bool "faraday data"
	config DUMMYSENSOR_RED
		bool "red data"
endchoice
```

## application/tracker/boards/vendor/techo/board.yml
```yaml
board:
  name: techo
  full_name: T-Echo Tracker
  vendor: vendor
  socs:
    - name: nrf52840
```

## application/tracker/boards/vendor/techo/techo_defconfig
```kconfig
# Enable MPU
CONFIG_ARM_MPU=y

# enable GPIO
CONFIG_GPIO=y

# enable uart driver
CONFIG_SERIAL=y

# enable console
CONFIG_CONSOLE=y
CONFIG_UART_CONSOLE=y

CONFIG_PINCTRL=y
CONFIG_SPI_BITBANG=y
CONFIG_SPI=y
```
